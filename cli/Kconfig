## cli/Kconfig
```kconfig
menu "cli: command shell"

    config CLI_MAX_GROUPS
        int "Maximum registered command groups"
        default 32
        range 4 128
        help
            Groups are registered at startup by the application and by any
            component that ships commands. The table holds pointers only; the
            groups themselves stay static const in the modules that define them.

    config CLI_MAX_LINE_LEN
        int "Maximum command line length (bytes)"
        default 256
        range 64 1024

    config CLI_MAX_ARGS
        int "Maximum tokens in a command line"
        default 32
        range 4 128
        help
            Includes the group token. A line with more tokens is truncated by
            the tokenizer, not rejected.

    config CLI_HISTORY_LEN
        int "Command history entries"
        default 32
        range 0 128

    config CLI_COMMAND_QUEUE_LEN
        int "Pending commands queued for the executor"
        default 4
        range 1 32
        help
            Every interface -- serial, web -- queues here, and one task drains
            it, so commands never run concurrently. Depth only covers bursts;
            it does not add parallelism.

    config CLI_EXECUTOR_STACK
        int "Executor task stack (bytes)"
        default 6144
        range 2048 32768
        help
            Every command runs on this task, including I2C scans and WiFi
            operations, so it needs more stack than a typical worker.

    config CLI_READER_STACK
        int "Serial reader task stack (bytes)"
        default 4096
        range 2048 16384

endmenu
```

## cli_web/Kconfig
```kconfig
menu "cli_web: browser transport for the shell"

    config CLI_WEB_MAX_OPEN_SOCKETS
        int "Maximum simultaneous HTTP sockets"
        default 7
        range 2 16
        help
            Every open browser tab holds a WebSocket for as long as it is on the
            page, so the httpd default of 4 runs out with a couple of tabs. Only
            applied when cli_web starts its own server; a borrowed server keeps
            whatever its owner configured.

    config CLI_WEB_BROADCAST_CHUNK
        int "Maximum bytes per WebSocket frame"
        default 512
        range 128 4096
        help
            Output longer than this is split across frames. Each chunk is
            malloc'd and handed to the server task, so larger values mean fewer,
            bigger allocations.

    config CLI_WEB_BROADCAST_QUEUE_LEN
        int "Output chunks that may be waiting for the broadcaster"
        default 16
        range 4 128
        help
            Output is queued to a task rather than pushed to the server from
            whatever task produced it, because a sink may run on lwIP's TCP/IP
            thread and must not make a socket call from there. This bounds how
            far the broadcaster may fall behind; past it, chunks are dropped and
            counted by cli_web_dropped().

    config CLI_WEB_TX_STACK
        int "Broadcaster task stack (bytes)"
        default 3072
        range 2048 8192
        help
            The task only moves queued chunks to the HTTP server's control
            socket, so it needs little beyond what a socket call costs.

    config CLI_WEB_MAX_COMMAND_LEN
        int "Maximum command length accepted from a browser (bytes)"
        default 512
        range 64 2048
        help
            Frames longer than this are ignored rather than truncated: a command
            cut in half is more dangerous than one that never ran.

endmenu
```

## diag/Kconfig
```kconfig
menu "diag: output fan-out"

    config DIAG_MAX_SINKS
        int "Maximum registered output sinks"
        default 4
        range 1 16
        help
            How many sinks may be attached at once, besides stdout. One per
            interface that must see command and log output -- a WebSocket
            console, an MQTT log topic, a file on the filesystem. The table is
            statically sized, so this costs memory whether or not it is used.

    config DIAG_FORMAT_BUF_SIZE
        int "Output formatting buffer size (bytes)"
        default 512
        range 128 4096
        help
            Output is formatted once into this buffer and then handed to stdout
            and to every sink, so all interfaces see byte-identical text. A line
            longer than this is truncated, not split. Statically allocated.

endmenu
```

## http_server/Kconfig
```kconfig
menu "http_server"

    config HTTP_SERVER_MAX_ROUTES
        int "Maximum registered routes"
        default 12
        range 2 32
        help
            Routes are copied into a statically sized table so they can be
            registered before the server starts and re-registered if it restarts.
            The httpd handler limit is sized from this.

endmenu
```

## int_dispatch/Kconfig
```kconfig
menu "int_dispatch"

    config INT_DISPATCH_MAX_HANDLERS
        int "Maximum handlers on the shared interrupt line"
        default 8
        range 1 32

endmenu
```

## mdns_manager/Kconfig
```kconfig
menu "mdns_manager"

    config MDNS_MANAGER_MAX_SERVICES
        int "Maximum advertised services"
        default 4
        range 1 16
        help
            Services are copied into a statically sized table so they survive to
            be re-advertised after a reconnect, and so a caller may register from
            a stack frame. This costs memory whether or not it is used.

endmenu
```

## mqtt_manager/Kconfig
```kconfig
menu "mqtt_manager"

    config MQTT_MANAGER_MAX_SUBSCRIPTIONS
        int "Maximum registered topic handlers"
        default 8
        range 1 32
        help
            Each entry holds a full topic filter, so this costs memory whether or
            not it is used. Subscriptions are re-applied on every reconnect, since
            a broker keeps no state for a client that dropped.

    config MQTT_LOG_SINK_MAX_SUFFIX_LEN
        int "Maximum log topic suffix length (bytes)"
        default 32
        range 8 128

endmenu
```

## ota/Kconfig
```kconfig
menu "ota"

    config OTA_HTTP_CHUNK_SIZE
        int "Upload chunk size (bytes)"
        default 1024
        range 512 8192
        help
            The image is received and written in chunks of this size, so a device
            with no PSRAM never holds more than this much of it. The buffer is
            static, not on the handler's stack.

endmenu
```
